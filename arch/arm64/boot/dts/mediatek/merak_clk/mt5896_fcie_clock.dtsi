// SPDX-License-Identifier: (GPL-2.0 OR BSD-3-Clause)
/*
 * Copyright (c) 2020 MediaTek Inc.
 */


/{
	fcie_sw_en: fcie_swen {
		#clock-cells = <1>;
		compatible = "mediatek,dtv_clk_gate_en";
		num = <2>;
		NONPM;

		smi_fcie2fcie {
			id = <CLK_FCIE_EN_SMI_FCIE2FCIE>;
			gate_shift = <5>;
			parent = "p_dummy";
			ctrl_reg = <0x14F0>;
		};

	};
};
