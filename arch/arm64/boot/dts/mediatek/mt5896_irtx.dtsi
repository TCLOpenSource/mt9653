// SPDX-License-Identifier: (GPL-2.0 OR BSD-3-Clause)
/*
 * Copyright (c) 2020 MediaTek Inc.
 */
/ {

	irtx: irtx{
				compatible = "mtk-irtx";
				reg = <0 0x1c062200 0 0x400>;
				clock-frequency = <216000000>;
				};


};
