// SPDX-License-Identifier: (GPL-2.0 OR BSD-3-Clause)
/*
 * Copyright (c) 2020 MediaTek Inc.
 */

/ {
	mediatek_drm_tv_kms:mediatek-drm-tv-kms {
		compatible = "MTK-drm-tv-kms";
		interrupt-parent = <&mtk_intc0_irq>;
		interrupts = <0x0 0x1E 0x4>;
	};
};
