// SPDX-License-Identifier: (GPL-2.0 OR BSD-3-Clause)
/*
 * Copyright (c) 2021 MediaTek Inc.
 */

/ {
	#address-cells = <2>;
	#size-cells = <2>;

	mtk_dvb_adapter:mtk-dvb-adapter {
		compatible = "mediatek,dvb-adapter";
		adap_nr {
			number = <0xff>;
		};
	};
};
