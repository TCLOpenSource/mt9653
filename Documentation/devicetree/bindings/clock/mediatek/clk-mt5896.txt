## Documentation/devicetree/bindings/clock/mediatek/clk-mt5896.txt
```
Device Tree Clock bindings for MediaTek mt5896

This binding uses the common clock binding[1].

[1] Documentation/devicetree/bindings/clock/clock-bindings.txt

Required properties:
- compatible: shall be one of the following:
	"mediatek,dtv_clk_fix":
		mediatek dtv fix rate clk group

	"mediatek,dtv_clk_fix_factor":
		mediatek dtv fix factor clk group

	"mediatek,dtv_clk_mux_gate":
		mediatek dtv mux-gate composite clk group

	"mediatek,dtv_clk_gate_en":
		mediatek dtv enable gate clk group

- #clock-cells: shall be 1

- num: clock number in the group

Required child node for fix rate clk group:

	Each child node indicates a fix rate clk in this group

	Required properties:
	- clock-frequency: clk freq(MHz) of the clock. The MAX num is 4294.
	- id: identity number of clock in corresponding provider

For example:
	topgen_fix: top-gen_fix {
		#clock-cells = <1>;
		compatible = "mediatek,dtv_clk_fix";
		num = <5>;

		dmdpll_clk {
			id = <12>;
			clock-frequency = <864>;
		};
	};

Required child node for fix factor clk group:

	Each child node indicates the parent clock with some different outputs of specific fix
	factor dividers. The outputs, shown as child nodes of the parent clock node, are the
	fix factor clocks of the group.

	Required properties of fix factor clk node:
	- id: identity number of clock in corresponding provider
	- div_factor: the multiplier and divisor

For example:
	topgen_fix_factor: top-gen_fix_factor {
		#clock-cells = <1>;
		compatible = "mediatek,dtv_clk_fix_factor";
		num = <3>;

		dmdpll_clk {
			clk_432_buf {
				id = <CLK_TOP_DMDPLL_D2>;
				div_factor = <1 2>;
			};
		};
	};

	This shows that group top-gen_fix_factor has a fix-factor clock clk_432_buf with
	parent dmdpll_clk and divider 1/2.


Required child node for mux-gate composite clk group:

	Each child node indicates a mux_gate clk in this group

	Required properties:
	- id: identity number of clock in corresponding provider
	- ctrl_reg: reg offset info
	- BIT: control bit indicator
	- mux_shift: start bit of mux control
	- mux_width: bit number of mux control
	- gate_shift: start_bit of gate conctrol
	- parents: name list of parent clocks in order

For example:

	subsys_mux_gate: subsys_mg {
		#clock-cells = <1>;
		compatible = "mediatek,dtv_clk_mux_gate";
		num = <CLK_SUBSYS_MG_NR>;

		clk_subsys_mg_test {
			id = <CLK_SUBSYS_MG_TEST>;
			ctrl_reg = <reg_ckgen00_dummy3>;
			BIT = <8 15>; /* control bit 8 to 15 */
			mux_shift = <2>; /* --> start bit of mux control */
			mux_width = <3>; /* --> bit number of mux control */
			gate_shift = <0>; /* --> start_bit of gate conctrol */
			parents = "clk_172_buf", "clk_36_buf", "clk_123_buf", "clk_192_buf",
			"clk_375k_buf", "clk_5p4_buf", "clk_evdpll_div2p5_buf";
		};
	};


Required child node for enable gate clk group:

	Each child node indicates a enable gate clock in this group

	Required properties:
	- id: identity number of clock in corresponding provider
	- reg_bank_offset: reg bank offset info
	- gate_shift: start_bit of gate conctrol
	- parent: the parent of clock

For example:

	enable_test: clktest_clk_enable {
		#clock-cells = <1>;
		compatible = "mediatek,dtv_clk_gate_en";
		num = <TEST_SIZE>;
		clk_enable_ok {
			id = <TEST_OK_INDEX>;
			reg_bank_offset = <0x600 0x7>; /* bank: 0x6, 16-bit addr : 0x9 */
			gate_shift = <3>;
			parent = "clk_27_buf";
		};
	};


The clock consumer should specify the desired clock by having the clock
ID in its "clocks" phandle cell. See include/dt-bindings/clock/mt5896-clk.h
for the full list of mt5896 clock IDs.
```

## Documentation/devicetree/bindings/gpio/mediatek,mt5870-gpio.txt
```
* Mediatek MT5870 SoC GPIO controller

The GPIO controller provides GPIO controls and interrupts.

Required properties for the top level node:
  - #gpio-cells : Should be two. The first cell is the GPIO pin number and the
      second cell specifies GPIO flags, as defined in <dt-bindings/gpio/gpio.h>.
      Only the GPIO_ACTIVE_HIGH and GPIO_ACTIVE_LOW flags are supported.
  - #interrupt-cells : Specifies the number of cells needed to encode an
      interrupt. Should be 2. The first cell defines the interrupt number,
      the second encodes the triger flags encoded as described in
      Documentation/devicetree/bindings/interrupt-controller/interrupts.txt
  - compatible:
      - "mediatek,mt5870-gpio" for Mediatek controllers
  - reg : Physical base address and length of the controller's registers
  - interrupt-parent : phandle of the parent interrupt controller.
  - interrupts : Interrupt specifier for the controllers interrupt.
  - interrupt-controller : Mark the device node as an interrupt controller.
  - gpio-controller : Marks the device node as a GPIO controller.
  - ngpios: number of PADs in this GPIO controller.
  - base: the start index of this GPIO controller.
  - sub-index: the index in the register bank.

Example:
	gpio_pm_gpio0: gpio@1f001e00 {
		compatible = "mediatek,mt5870-gpio";
		reg = <0x0 0x1f001e00 0x0 0x200>;
		gpio-controller;
		#gpio-cells = <2>;
		ngpios = <28>;
		base = <4>;
		sub-index = <0>;
		interrupts = <0 55 0x4>;
	};
```

## Documentation/devicetree/bindings/hwlock/mt5870-hwspinlock.txt
```
MTK MT5870 Hardware spinlock device Binding
-----------------------------------------------

Required properties :
- compatible : shall contain only one of the following:
	"mediatek,mt5870-hwspinlock"

- reg : the register address of hwspinlock

- #hwlock-cells : hwlock users only use the hwlock id to represent a specific
	hwlock, so the number of cells should be <1> here.

Please look at the generic hwlock binding for usage information for consumers,
"Documentation/devicetree/bindings/hwlock/hwlock.txt"

Example of hwlock provider:
	hwlock: hwspinlock@0x1f203000 {
		compatible = "mediatek,mt5870-hwspinlock";
		reg = <0x0 0x1f203000 0x0 0x40>;
		#hwlock-cells = <1>;
	};

Example of hwlock users:
	node {
		...
		hwlocks = <&hwlock 2>;
		...
	};
```

## Documentation/devicetree/bindings/hwlock/mt5896-hwspinlock.txt
```
MTK MT5896 Hardware spinlock device Binding
-----------------------------------------------

Required properties :
- compatible : shall contain only one of the following:
	"mediatek,mt5896-hwspinlock"

- reg : the register address of hwspinlock

- #hwlock-cells : hwlock users only use the hwlock id to represent a specific
	hwlock, so the number of cells should be <1> here.

Please look at the generic hwlock binding for usage information for consumers,
"Documentation/devicetree/bindings/hwlock/hwlock.txt"

Example of hwlock provider:
	hwlock: hwspinlock@0x1c604000 {
		compatible = "mediatek,mt5896-hwspinlock";
		reg = <0x0 0x1f604000 0x0 0x40>;
		#hwlock-cells = <1>;
	};

Example of hwlock users:
	node {
		...
		hwlocks = <&hwlock 2>;
		...
	};
```

## Documentation/devicetree/bindings/i2c/i2c-mt5870.txt
```
* MediaTek MT5870 I2C master controller

The MediaTek MT5870 I2C controller is used to interface with I2C devices.

Required properties:

  - compatible: must be "mediatek,mt5870-i2c"
  - reg: physical base address and length of the control registers.
  - interrupts: interrupt number to the cpu.
  #- TODO: add clocks after clock framework ready
  - #address-cells: should be <1>
  - #size-cells: should be <0>
  #- TODO: remove pad-mode after pinctrl ready
  - pad-mode: pad mux setting for SDA, SCL
  #- TODO: add pinctrl-names and pinctrl-0 after pinctrl ready

Optional properties:

  - clock-frequency: Frequency in Hz of the bus when transfer, the default value
    is 100000.
  - start-count: Start condition count, ie. clock(s) between SDA falling and SCL
    falling. The default value is 73.
  - stop-count: Stop condition count, ie. clock(s) between SCL rising and SDA
    rising. The default value is 73.
  - sda-count: SDA hold time, ie. clock(s) between falling edge SCL and SDA
    output. The default value is 5.
  - latch-count: Data latch timing. The default value is 5.
  - scl-stretch: Enable/disable i2c clock stretch

  May specify i2c bus number by adding aliases.

Example:

	aliases {
		/* let i2c sub system set i2c bus index by aliases */
		/* bus index = &bus module */
		i2c0 = &i2c_3;
	};

	i2c_3: i2c@1F223400 {
		compatible = "mediatek,mt5870-i2c";
		reg = <0 0x1F223400 0 0x200>;
		#address-cells = <1>;
		#size-cells = <0>;
		/* TODO: set clock after clock driver ready */
		/* clocks = <&CLK_miic3>; */
		interrupts=<0x0 0x3f 0x4>;
		clock-frequency = <100000>; /* bus speed 100 KHz */
		/* pad mux setting for SDA, SCL */
		/* TODO: modify after pinctrl finish */
		pad-mode = <2>;
		/* proprietary i2c parameter */
		start-count = <73>;
		stop-count = <73>;
		sda-count = <5>;
		latch-count = <5>;
		scl-stretch;
		status = "okay";
	};
```

## Documentation/devicetree/bindings/iio/adc/mt5896_saradc.txt
```
Device-Tree bindings for MediaTek MT5896 SoC based SARADC

Required properties:
- compatible	    : Should be
			"mt5896,saradc" : for MT5896 SoC
- reg 		    : Specifies base physical address and size of the registers;


Example:

	saradc {
		compatible = "mt5896,saradc";
		interrupt-parent = <&mtk_intc2_irq_high>;
		reg = <0 0x1f020a00 0 0x200>;
		interrupts = <0x0 0x10 0x4>;
	};
```

## Documentation/devicetree/bindings/input/keypad-mt5896.txt
```
Device-Tree bindings for MediaTek MT5896 SoC based KeyPad

Required properties:
- compatible	    : Should be
			"mediatek,mt5896-spi" : for MT5896 SoC
- reg 		    : Specifies base physical address and size of the registers;
- mtk, keypad-chanel : keypad PCB channel
- mtk, keypad-lowbd  : keypad low bound adc trigger interrupt
- mtk, keypad-upwbd  : keypad high bound adc trigger interrupt
- mtk, keypad-num    : keypad PCB key supported

Example:

	keypad {
		compatible = "mediatek,mt5896-keypad";
		interrupt-parent = <&mtk_intc2_irq_high>;
		reg = <0 0x1f020a00 0 0x200>;
		interrupts = <0x0 0x10 0x4>;
		mtk,keypad-chanel = <1>;
		mtk,keypad-lowbd = <848>;
		mtk,keypad-upwbd = <1023>;
		mtk,keypad-num = <2>;

		key_1 {
			linux,code = <0x8b>;
			keypad,threshold = <0x339>;
		};
		key_2 {
			linux,code = <0x4F>;
			keypad,threshold = <0x2DB>;
		};
	};
```

## Documentation/devicetree/bindings/input/mtk-ir.txt
```
* MTK IR_IN device tree bindings

Registers a ir_in device as irda input device.

Required properties:
- compatible: should be "mtk-ir"
- reg: ir_in register bank to the physical ir_in device
- interrupts: ir_in irq number.

Example:
	ir_in: ir_in@1c008000{
		compatible = "mtk-ir";
		reg = <0x0 0x1c008000 0 0x80>;
		interrupt-parent = <&mtk_intc2_fiq_high>;
		interrupts = <0x0 0x15 0x4>;
	};
```

## Documentation/devicetree/bindings/iommu/mediatekdtv,iommu.txt
```
SOC MACHINE for mt5870

Required properties:
- compatible: "mediatek,dtv-iommu"
- iommu-cells : must be 1

Example:
	iommu: iommu {
		compatible = "mediatek,dtv-iommu";
		#iommu-cells = <1>;
	};

Example for a client device:
	iommu_test: iommu_test {
		compatible = "mediatek,dtv-iommu-test";
		iommus = <&iommu 0>;
	};

	ion_iommu: ion {
		compatible = "mediatek,dtv-iommu-ion";
		iommus = <&iommu 0>;
	};
Example for iommu cma:
	iommu-cma0 {
		compatible = "mediatek,dtv-iommu-cma0";
	};
	iommu-cma1 {
		compatible = "mediatek,dtv-iommu-cma1";
	};
```

## Documentation/devicetree/bindings/mailbox/mtk,mt5896-mailbox-mexico.txt
```
MediaTek Mailbox Wrapper
===============

Mailbox Wrapper for mailbox client who does not have dts node
to request mbox channel.

Required properties:
- compatible: should be "mediatek,mt5896-mbox-mexico".
- mboxes: List of phandle and mailbox channel specifiers. Args
	  in mboxes here is to recognize the remote target for
	  wrapper driver.

Example:
	mailbox_mexico_to_pm51: mailbox_mexico_to_pm51 {
		compatible = "mediatek,mt5896-mbox-mexico";
		mboxes = <&mailbox_to_pm51 MBOX_REMOTE_PM51>;
	};
```

## Documentation/devicetree/bindings/memory-controllers/mediatek,dtv-miup.txt
```
Device-Tree bindings for MediaTek DTV SoC based Memory

Required properties:
- compatible : must be:
	"mediatek,mtk-miup"
- reg : the register and size of the miu protect base.
- interrupts : Should contain the interrupt for memory protect hit log.
- mediatek,max_prot_blk : Maximum number of protect block of memory protect.
- mediatek,max_cid_group : Maximum number of client group.
- mediatek,max_cid_number : Maximum number of client number of each client group.

Example:
	mtk_miup: miup@1f603400 {
		compatible = "mediatek,mtk-miup";
		reg = <0 0x1f603400 0 0x200>,
		  <0 0x1f620E00 0 0x200>,
		  <0 0x1f621000 0 0x200>,
		  <0 0x1f621200 0 0x200>;
		interrupts = <0x0 0x22 0x4>;
		mediatek,max_prot_blk = <8>;
		mediatek,max_cid_group = <2>;
		mediatek,max_cid_number = <16>;
	};
```

## Documentation/devicetree/bindings/net/mediatek,mt5896-gmac.txt
```
Device-Tree bindings for MediaTek MT5896 SoC based GMAC gigabit ethernet

Required properties:
- compatible	    : Should be
			"mediatek,mt5896-gmac" : for MT5896 SoC
- reg 		    : Specifies base physical address and size of the registers;
- interrupts	    : Should contain the interrupt for GMAC;
- clocks	    : Specifies list of clock specifiers, corresponding to
		      entries in clock-names property;
- clock-names	    : Should contain "rtc" entries
- local-mac-address : Give a default mac address, if mac address cannot get from bootloader
- internal-phy      : Use internal phy, else use external phy
- force-10m         : Force ethernet speed as 10M full duplex
- force-100m        : Force ethernet speed as 100M full duplex
                      If no ether force-10m and force-100m, use auto-negtiation

Example:

	gmac: gmac@1c700000 {
		compatible = "mediatek,mt5896-gmac";
		reg = <0 0x1c700000 0 0x200>, /* x32 gmac0 */
		      <0 0x1c700800 0 0x800>, /* x16 ogmac1*/
		      <0 0x1c084000 0 0x600>,
		      <0 0x1c204000 0 0x4000>,
		      <0 0x1c022000 0 0x200>;
		local-mac-address = [00 99 88 77 66 00];
		interrupt-parent = <&mtk_intc0_irq>;
		interrupts = <0x0 0x37 0x4>;
		/*internal-phy;*/
		force-10m;
	};
```

## Documentation/devicetree/bindings/pwm/pwm-mt5870.txt
```
Mediatek MT5870 PWM controller

Required properties:

 - compatible: must be "mediatek,mt5870-pwm"
 - reg: physical base address and length for this controller
 - #pwm-cells: must be 2. See pwm.txt in this directory for a description of
   the cell format.
 - clocks: XTAL


Example:

	pwm: pwm {
		compatible = "mediatek,mt5870-pwm";
		reg = <0 0x1f206400 0 0x200>;
		#pwm-cells = <2>;
	};
```

## Documentation/devicetree/bindings/pwm/pwm-mt5896.txt
```
Device-Tree bindings for MediaTek MT5896 SoC based RTC

Required properties:
- compatible	    : Should be
			"mediatek,mt5896-pwm" : for MT5896 SoC
- reg 		    : Specifies base physical address and size of the registers;

Example:

	pwm0@1c487200 {
		compatible = "mediatek,mt5896-pwm";
		reg = <0 0x1c487200 0 0x200>;
	};
```

## Documentation/devicetree/bindings/rtc/rtc-mt5896.txt
```
Device-Tree bindings for MediaTek MT5896 SoC based RTC

Required properties:
- compatible	    : Should be
			"mediatek,mt5896-rtc" : for MT5896 SoC
- reg 		    : Specifies base physical address and size of the registers;
- interrupts	    : Should contain the interrupt for RTC alarm;
- clocks	    : Specifies list of clock specifiers, corresponding to
		      entries in clock-names property;
- clock-names	    : Should contain "rtc" entries
- default-cnt	    : Specifies the initial default time for RTC

Example:

rtc: rtc@1f002400 {
	compatible = "mediatek,mt5896-rtc";
	reg = <0 0x1c020600 0 0x200>,
	      <0 0x1c020200 0 0x200>;
	interrupt-parent = <&mtk_intc2_irq_high>;
	interrupts = <0x0 0x18 0x4>;
	xtal = <12000000>;
	freq = <1>;
	default-cnt = <946684800>;
};
```
