// SPDX-License-Identifier: (GPL-2.0 OR BSD-3-Clause)
/*
 * Copyright (c) 2020 MediaTek Inc.
 */

/ {
	frccore1_mux_gate: frccore1_mg {
		#clock-cells = <1>;
		compatible = "mediatek,dtv_clk_mux_gate";
		num = <MT5897_FRCCORE1_NR>;

		frc_core1_frc_fclk_2x_int_ck {
			id = <CLK_FRCCORE1_FRC_CORE1_FRC_FCLK_2X_INT_CK>;
			parents = "frc_fclk_2x_ck","frc_fclk_ck","frc_fclk_2xplus_ck","1'b0";
		};

	};
};
