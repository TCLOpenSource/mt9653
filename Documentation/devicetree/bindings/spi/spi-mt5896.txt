## Documentation/devicetree/bindings/spi/spi-mt5896.txt
```
Device-Tree bindings for MediaTek MT5896 SoC based RTC

Required properties:
- compatible	    : Should be
			"mediatek,mt5896-spi" : for MT5896 SoC
- reg 		    : Specifies base physical address and size of the registers;

Example:

	mspi@1c640800 {
		compatible = "mediatek,mt5896-spi";
		interrupt-parent = <&mtk_intc2_irq_low>;
		interrupts = <0x0 0x5 0x4>;
		reg = <0 0x1c640800 0 0x200>;
		spidev@1{
			compatible = "spidev";
			reg = <0>;
			spi-max-frequency = <2000000>;
			};
	};
```

## Documentation/devicetree/bindings/srccap/mtk_srccap.txt
```
Mediatek Srccap Documentation

Required properties:
	- compatible: shall be one of the following:
	"mediatek,srccap0":
		mediatek srccap0 group
	"mediatek,srccap1":
		mediatek srccap1 group

Optional properties:
	- unique-id : unique-id of the device
	- interrupts : interrupt numbers
	- reg : reg base and size
	- capability : hw capability
	- port_map : input source and input port mapping

Example device nodes:
	mtk_srccap0: mtk_srccap0@0x1F000000 {
		compatible = "mediatek,srccap0";

		unique-id = <3000>;
		interrupts = <35>;
		reg = <0x0 0x0>;
		capability = <0x24111100>;
		port_map {
			input_num = <8>;
			input0 {
				source = <10>;
				data_port = <130>;
				sync_port = <0>;
			};
			input1 {
				source = <11>;
				data_port = <131>;
				sync_port = <0>;
			};
			input2 {
				source = <12>;
				data_port = <132>;
				sync_port = <0>;
			};
			input3 {
				source = <13>;
				data_port = <133>;
				sync_port = <0>;
			};
			input4 {
				source = <20>;
				data_port = <50>;
				sync_port = <0>;
			};
			input5 {
				source = <30>;
				data_port = <51>;
				sync_port = <110>;
			};
			input6 {
				source = <40>;
				data_port = <10>;
				sync_port = <0>;
			};
			input7 {
				source = <50>;
				data_port = <11>;
				sync_port = <31>;
			};
		};
	};

	mtk_srccap1: mtk_srccap1@0x1F000000 {
		compatible = "mediatek,srccap0";

		unique-id = <3000>;
		interrupts = <35>;
		reg = <0x0 0x0>;
		capability = <0x24111100>;
		port_map {
			input_num = <8>;
			input0 {
				source = <10>;
				data_port = <130>;
				sync_port = <0>;
			};
			input1 {
				source = <11>;
				data_port = <131>;
				sync_port = <0>;
			};
			input2 {
				source = <12>;
				data_port = <132>;
				sync_port = <0>;
			};
			input3 {
				source = <13>;
				data_port = <133>;
				sync_port = <0>;
			};
			input4 {
				source = <20>;
				data_port = <50>;
				sync_port = <0>;
			};
			input5 {
				source = <30>;
				data_port = <51>;
				sync_port = <110>;
			};
			input6 {
				source = <40>;
				data_port = <10>;
				sync_port = <0>;
			};
			input7 {
				source = <50>;
				data_port = <11>;
				sync_port = <31>;
			};
		};
	};
```

## Documentation/devicetree/bindings/thermal/mt58xx-thermal.yaml
```yaml
# SPDX-License-Identifier: (GPL-2.0 OR BSD-2-Clause)
%YAML 1.2
---
$id: http://devicetree.org/schemas/thermal/mt58xx-thermal.yaml#
$schema: http://devicetree.org/meta-schemas/core.yaml#

title: mt58xx thermal sensor controller bindings

maintainers:
  - Mark-PK Tsai <mark-pk.tsai@mediatek.com>

description: |+
  Mediatek TV SoCs contain multiple thermal sensors.
  The driver is similar to generic-adc except the value read from ADC
  can't use voltage-thermal look-up table to calculate the temperature.
  Instead, use the below equation to get the temperature.
    Tj = (Vref - V) * Vslope + Tref

properties:
  compatible:
    const: mt58xx-thermal

  "#thermal-sensor-cells":
    const: 1

  io-channels:
    description:
      From common IIO binding.

  io-channel-names:
    const: thermal

  mediatek,thermal-config:
    description: |
      mt58xx thermal sensor configuraiton. <Vref Tref Vslope>
    $ref: /schemas/types.yaml#/definitions/uint32-matrix
    items:
      minItems: 3
      maxItems: 3

required:
  - compatible
  - io-channels
  - io-channel-names
  - "#thermal-sensor-cells"
  - mediatek,thermal-config

examples:
  - |
	tsensor_apu: mtk-sensor@14 {
		compatible = "mt58xx-thermal";
		#thermal-sensor-cells = <1>;
		io-channels = <&saradc 14>;
		io-channel-names = "thermal";
		mediatek,thermal-config = <772 24000 770>;
	};
...
```

## Documentation/devicetree/bindings/watchdog/mt5870-wdt.txt
```
Mediatek mt5870 SoC WDT controller

Required properties:

- compatible: must be "mediatek,mt5870-wdt"
- reg: physical base address and length for this controller
- clocks: XTAL


Example:

	wdt{
	   compatible = "mediatek,mt5870-wdt";
	   reg = <0 0x1f006000 0 0x200>;
	};
```

## Documentation/devicetree/bindings/watchdog/wdt-mt5896.txt
```
Device-Tree bindings for MediaTek MT5896 SoC based wdt

Required properties:
- compatible	    : Should be
			"mediatek,mt5896-wdt" : for MT5896 SoC
- reg 		    : Specifies base physical address and size of the registers;

Example:

	wdt0 {
		compatible = "mediatek,mt5896-wdt";
		interrupt-parent = <&mtk_intc2_fiq_high>;
		interrupts = <0x0 0x1 0x4>;
		reg = <0 0x1c400600 0 0x200>,
			<0 0x1c020000 0 0x200>;
	};
```
