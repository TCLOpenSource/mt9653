## Documentation/devicetree/bindings/serial/mediatek-tv,ns16550.txt
```
* MediaTek Universal Asynchronous Receiver/Transmitter (UART)

Required properties:
- compatible should contain:
  * "mediatek_tv,ns16550" for MT5870 compatible UARTs

- reg: The base address of the UART register bank.

- interrupts:
  index 0: an interrupt specifier for the UART controller itself
  index 1: optional, an interrupt specifier with edge sensitivity on Rx pin to
           support Rx in-band wake up.

- clocks : Must contain an entry for each entry in clock-names.
  See ../clocks/clock-bindings.txt for details.

For compatibility with older device trees an unnamed clock is used for the
baud clock if the baudclk does not exist. Do not use this for new designs.

Example:

	uart0: serial@1f201300{
		compatible = "mediatek_tv,ns16550";
		reg = <0x0 0x1f201300 0 0x20>;
		current-speed = <115200>;
		device_type = "serial";
		clock-frequency = <123000000>;
		interrupt-parent = <&mtk_intc0>;
		interrupts = <0x0 0x0 0x4>;
		reg-shift = <3>;
		uart-device-id = <0>;
	};
```

## Documentation/devicetree/bindings/sound/mtk-mt5870-evb.txt
```
Mediatek DTV ASOC MACHINE for mt5870

Required properties:
- compatible: "mediatek,mtk-snd-machine"
- mediatek DTV,platform: MT5870 ASoC platform
- pre_init_table: audio pre-init table path
- init_table: audio init table path

Example:

mtk-sound-machine {
		compatible = "mediatek,mtk-snd-machine";
		pre_init_table = "/config/audio/audio_pre_init.ini";
		init_table = "/config/audio/audio_init.ini";
	};
```

## Documentation/devicetree/bindings/sound/mtk-sound-amp-rt9114.txt
```
Mediatek DTV AMP RT9114 Controller

Required properties:
- compatible: "mediatek,amp","mediatek, rt9114"
- reg: i2c slave address
- ampmute-gpios: amp mute gpio
- ampreset-gpios: amp reset gpio
- ampreset-reg: amp reset register when gpio not register at dts
- reset-invertor: gpio reset invertor
- mute-invertor: gpio mute invertor

Example:

mtk-amp@1B {
	#address-cells = <1>;
	#size-cells = <1>;
	compatible = "mediatek,amp","mediatek, rt9114";
	reg = <0x1B>;
	status = "okay";
	ampreset-gpios = <&gpio_sar0 3 GPIO_ACTIVE_HIGH>;
	ampmute-gpios = <&gpio_pm_gpio0 7 GPIO_ACTIVE_HIGH>;
	ampreset-reg = <0x322b16>;
	reset-invertor = <1>;
	mute-invertor = <1>;
};
```

## Documentation/devicetree/bindings/sound/mtk-sound-capture-pcm.txt
```
Mediatek DTV DSP CAPTURE PCM Controller for mt5870

Required properties:
- compatible: "mediatek,mtk-capture-platform"
- mediatek DTV,platform: MT5870 ASoC platform

Example:

mtk-sound-capture-platform {
		compatible = "mediatek,mtk-capture-platform";
		interrupt-parent = <&mtk_intc1>;
		interrupts = <0x0 0x6 0x4>,
		<0x0 0x7 0x4>;
	};
```

## Documentation/devicetree/bindings/sound/mtk-sound-coprocessor-platform.txt
```
Mediatek DTV DSP platform Controller for mt5870

Required properties:
- compatible: "mediatek,mtk-coprocessor-platform"
- mediatek DTV,platform: MT5870 ASoC platform

Example:

mtk-sound-coprocessor-platform {
		compatible = "mediatek,mtk-coprocessor-platform";
		dsp_name = "dsp.bin";
		miu_bank = <0>;
	};
```

## Documentation/devicetree/bindings/sound/mtk-sound-digital-playback-pcm.txt
```
Mediatek DTV DSP DMA Digital PCM Controller for mt5870

Required properties:
- compatible: "mediatek,mtk-digital-playback-platform"
- mediatek DTV,platform: M7332 ASoC platform

Example:

mtk-sound-playback-platform {
		compatible = "mediatek,mtk-digital-playback-platform";
	};
```

## Documentation/devicetree/bindings/sound/mtk-sound-duplex-pcm.txt
```
Mediatek DTV SRC PCM Controller for mt5870

Required properties:
- compatible: "mediatek,mtk-duplex-platform"
- mediatek DTV,platform: MT5870 ASoC platform

Example:

mtk-sound-duplex-platform {
		compatible = "mediatek,mtk-duplex-platform";
	};
```

## Documentation/devicetree/bindings/sound/mtk-sound-mt5870.txt
```
Mediatek DTV MT5870

Required properties:
- compatible: "mediatek,mtk-snd-mt5870"
- mediatek DTV,platform: MTK ASoC platform

Example:

mtk_sound_soc: mtk-sound-soc {
		compatible = "mediatek,mtk-snd-mt5870";
		riu_base = <0x1F000000>;
		audio_bank_num = <22>;
		reg = <0x0 0x1F225400 0x0 0x200>,	/* 112A00 */
		      <0x0 0x1F225600 0x0 0x200>,	/* 112B00 */
		      <0x0 0x1F225800 0x0 0x200>,	/* 112C00 */
		      <0x0 0x1F225A00 0x0 0x200>,	/* 112D00 */
		      <0x0 0x1F225C00 0x0 0x200>,	/* 112E00 */
		      <0x0 0x1F225E00 0x0 0x200>,	/* 112F00 */
		      <0x0 0x1F2C0400 0x0 0x200>,	/* 160200 */
		      <0x0 0x1F2C0600 0x0 0x200>,	/* 160300 */
		      <0x0 0x1F2C7800 0x0 0x200>,	/* 163C00 */
		      <0x0 0x1F2C7A00 0x0 0x200>,	/* 163D00 */
		      <0x0 0x1F2C7C00 0x0 0x200>,	/* 163E00 */
		      <0x0 0x1F2C7E00 0x0 0x200>,	/* 163F00 */
		      <0x0 0x1F222C00 0x0 0x200>,	/* 111600 */
		      <0x0 0x1F222E00 0x0 0x200>,	/* 111700 */
		      <0x0 0x1F225200 0x0 0x200>,	/* 112900 */
		      <0x0 0x1F2C6000 0x0 0x200>,	/* 163000 */
		      <0x0 0x1F626C00 0x0 0x200>,	/* 313600 */
		      <0x0 0x1F2A3600 0x0 0x200>,	/* 151B00 */
		      <0x0 0x1F2A3800 0x0 0x200>,	/* 151C00 */
		      <0x0 0x1F620400 0x0 0x200>,	/* 310200 */
		      <0x0 0x1F206600 0x0 0x200>,	/* 103300 */
		      <0x0 0x1F644800 0x0 0x200>;	/* 322400 */
	};
```

## Documentation/devicetree/bindings/sound/mtk-sound-playback-pcm.txt
```
Mediatek DTV DSP DMA PCM Controller for mt5870

Required properties:
- compatible: "mediatek,mtk-playback-platform"
- mediatek DTV,platform: M7332 ASoC platform

Example:

mtk-sound-playback-platform {
		compatible = "mediatek,mtk-playback-platform";
	};
```

## Documentation/devicetree/bindings/spi/spi-mt5870.txt
```
Mediatek MT5870 spi controller

Required properties:

- compatible: must be "mediatek,mt5870-spi"
- reg: physical base address and length for this controller
- #address-cells: should be 1.
- #size-cells: should be 0.
- clocks: XTAL

Example:

spi@0x1f2a7400 {
	compatible = "mediatek,mt5870-spi";
	reg = <0 0x1f2a7400 0 0x200>;
	interrupts = <0x0 0x43 0x4>;
	mspi_channel = <0>;
	#address-cells = <1>;
	#size-cells = <0>;
};
```
