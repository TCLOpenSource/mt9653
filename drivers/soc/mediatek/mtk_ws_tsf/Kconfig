## drivers/soc/mediatek/mtk_ws_tsf/Kconfig
```kconfig
# SPDX-License-Identifier: GPL-2.0-only
#
# Counter devices
#

menuconfig MTKTV_WS_TSF
	tristate "ws_tsf support"
	default m
	help
	  This enables wireless speaker getting tsf time feature.
```

## drivers/soc/mediatek/mzc/Kconfig
```kconfig
config MTK_MZCCMDQ_HW
        bool "HW MZC + CMDQ"
        help
	Say yes here to add support for the MediaTek ZRAM Related driver.
	MTK ZRAM Related driver
	includes MZC-drive, MTK-ZRAM and MTK-ZSMALLOC.
	The MTK ZRAM device is used as swap-device.
config MTKZRAM_KO
	tristate "MTK Compressed RAM block device kernel driver support"
	help
	Say yes here to add support for the MediaTek ZRAM driver.
	MTK ZRAM is a hardware codec based zram driver which
	perfroms better than origin.
	The MTK ZRAM device is used as swap-device.
config MTKZSMALLOC_KO
	tristate "MTK Memory allocator kernel driver for compressed pages"
	help
	Say yes here to add support for the MediaTek ZSMALLOC driver.
	MTK ZSMALLOC, which is build for MZC codec
	reducing unnecessary overhead.
	The MTK ZSMALLOC device is used as zs allocator.
```

## drivers/soc/mediatek/realtime/Kconfig
```kconfig
config MTK_REALTIME_FRAMEWORK
	tristate "MTK Realtime Framework Kernel Module"
	help
	Say yes here to add support for the MediaTek realtime framework fuunctions.
```

## drivers/soc/mediatek/zdec/Kconfig
```kconfig
config MTK_ZDEC
        tristate "ZDEC"
        help
	Say yes here to add support for the MediaTek ZDEC Related driver.
	MTK ZDEC Related driver
	includes ZDEC-drive.
	The MTK ZDEC device is used.
config MTK_ZDEC_ASYNC_MODE
	bool "ZDEC_SYNC_ASYNC"
 	depends on MTK_ZDEC
	help
	Say yes here to add support for the MediaTek ZDEC async mode.
	MTK ZDEC is a hardware decoder based zilb which
	perfroms better than origin.
	The MTK ZDEC device is used for decoding.
config MTK_ACP_MODE
	bool "ACP Switch"
	depends on MTK_ZDEC
	help
	Say yes here to add support for the MediaTek ZDEC acp mode.
	MTK ZDEC, which is build for zlib decoder
	reducing unnecessary overhead.
	Say yes here to add support for ACP Mode.
config MTKZDEC_KO
	tristate "MTK zdec kernel driver support"
	help
		Say yes here to add support for the externel MediaTek ZDEC driver.
		Say yes here to add support for the externel MediaTek ZDEC driver.
		Say yes here to add support for the externel MediaTek ZDEC driver.
```

## kernel/trace/mtk-tv-atrace/Kconfig
```kconfig
# SPDX-License-Identifier: GPL-2.0-only
#

config MTK_TV_ATRACE
	tristate "MTK TV atrace"
	depends on TRACING
	help
	  This option measures the module time and counts
```
