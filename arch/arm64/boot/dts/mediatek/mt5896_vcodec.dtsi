// SPDX-License-Identifier: (GPL-2.0 OR BSD-3-Clause)
/*
 * Copyright (c) 2020 MediaTek Inc.
 */

/ {
	mtk_vcodec_dec: mtk-vcodec-dec {
		compatible = "mediatek,mt5870-vcodec-dec";
		mediatek,vcu = <&vcu>;
		iommus = <&iommu 0>;
	};

	mtk_vcodec_enc: mtk-vcodec-enc {
		compatible = "mediatek,m5870-vcodec-enc";
		mediatek,vcu = <&vcu>;
		iommus = <&iommu 0>;
	};
};
