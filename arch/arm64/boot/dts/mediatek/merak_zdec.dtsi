// SPDX-License-Identifier: (GPL-2.0 OR BSD-3-Clause)
/*
 * Copyright (c) 2020 MediaTek Inc.
 */

/ {
	#address-cells = <2>;
	#size-cells = <2>;

	ZDEC {
		compatible = "ZDEC";
		reg = <0 0x1c464e00 0 0x200>;   //bank number 0x2327 zdec_bank size 80
		interrupt-parent = <&mtk_intc0_irq>;
		interrupts = <0x0 0x3a 0x4>;
	};
};
