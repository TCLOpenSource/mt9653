## arch/arm64/configs/mt5896_defconfig
```kconfig
CONFIG_ARM_MTKTV_CPUFREQ=m
CONFIG_ARM_MTKTV_CPUFREQ_CA=m
CONFIG_ARM_MTKTV_CPUFREQ_DBG=m
CONFIG_COMMON_CLK_MEDIATEK_DBG=m
CONFIG_CPU_FREQ_GOV_ONDEMAND=m
CONFIG_HWSPINLOCK_MT5896=m
CONFIG_IPACK_BUS=m
CONFIG_IR_MTK_PMU=m
CONFIG_IRS_MTK=m
CONFIG_IRTX_MTK=m
CONFIG_MIC_MUTE_MTK=m
CONFIG_KEYPAD_MT5896=m
CONFIG_KEYPAD_MTK_PMU=m
CONFIG_LCD_CLASS_DEVICE=m
CONFIG_MEDIA_ANALOG_TV_SUPPORT=y
CONFIG_MEDIA_DIGITAL_TV_SUPPORT=y
CONFIG_DVB_CORE=m
CONFIG_DVB_PLATFORM_DRIVERS=y
CONFIG_DVB_MMAP=y
CONFIG_DVB_DYNAMIC_MINORS=y
CONFIG_DVB_CA_EN50221_REDUCE_RESET_TIME=y
CONFIG_DVB_CA_EN50221_SLOT_INFO_CHECK_STATUS=y
CONFIG_DVB_LGDT330X=n
CONFIG_MEDIA_CONTROLLER_DVB=y
CONFIG_ETHERNET=y
CONFIG_NET_VENDOR_MEDIATEK=y
CONFIG_MEDIATEK_DVB_ADAPTER=m
CONFIG_MEDIATEK_DVB_CI=m
CONFIG_MEDIATEK_DVB_DEMUX2=m
CONFIG_MEDIATEK_DVB_SC=m
CONFIG_MSTAR_UTIL=m
CONFIG_MT5896_SARADC=m
CONFIG_MT5896_WATCHDOG=m
CONFIG_MTKTV_CPU_THERMAL=m
CONFIG_MTKZRAM_KO=m
CONFIG_MTKZSMALLOC_KO=m
# CONFIG_MTK_MZCCMDQ_HW=y
CONFIG_MTK_ZDEC=m
CONFIG_MTKZDEC_KO=m
CONFIG_MTK_ACP_MODE=y
CONFIG_MTK_BW_DBG=m
CONFIG_MTK_IOMMU_DTV=m
CONFIG_MTK_MIUP=m
CONFIG_MTK_MIUP_DBG=m
CONFIG_MTK_PM=m
# CONFIG_MTK_BOOTTIME=m
CONFIG_MTK_PMU_RPROC=m
CONFIG_MTK_PQU_RPROC=m
CONFIG_MTK_PQU_RPROC=m
CONFIG_MTK_REALTIME_FRAMEWORK=m
CONFIG_MTK_SMI_TV=m
CONFIG_MTK_TV_IR_DYNAMIC_CONFIG=m
CONFIG_MTK_TV_IR_IN=m
CONFIG_MTK_CMDQ=m
CONFIG_MTK_CMDQ_MBOX=m
# CONFIG_MTK_CMDQ_MBOX_EXT=m
CONFIG_NET_MEDIATEK_MT5896=m
CONFIG_OPTEE=m
CONFIG_OPTEE_SHM_NUM_PRIV_PAGES=3
CONFIG_PHY_MTK_TPHY=m
CONFIG_PWM_MT5896=m
CONFIG_PWM_MTK_PMU=m
CONFIG_REGULATOR_MT5896=m
CONFIG_REGULATOR_MT5876=m
CONFIG_RTC_DRV_MT5896=m
CONFIG_SAMPLES=y
CONFIG_SAMPLE_MTK_RPMSG_TEST=m
CONFIG_SAMPLE_RPMSG_CLIENT=m
CONFIG_SND_DRIVERS=y
CONFIG_SND_ALOOP=m
CONFIG_SND_MT5896=m
CONFIG_SND_SOC_MEDIATEK_DTV=m
CONFIG_SPI_MT5896=m
CONFIG_TEE=m
CONFIG_TEST_POWER=m
CONFIG_USB_MTU3=m
CONFIG_USB_MU3_PHY=m
CONFIG_USB_MTK_DTV_XHCI=y
CONFIG_USB_XHCI_MTK=m
CONFIG_VIDEO_MEDIATEK_CEC=m
CONFIG_VIDEO_MEDIATEK_PMU_CEC=m
CONFIG_VIDEO_MEDIATEK_JPD=m
CONFIG_I2C_MT5896=m
CONFIG_MTK_MEMORY=m
CONFIG_SPI_MTK_RPMSGDTV=m
CONFIG_MMC_MTK_FCIE=m
CONFIG_COMMON_CLK_MEDIATEK_TV=m
CONFIG_COMMON_CLK_MT5896=m
CONFIG_MT58XX_IRQ=m
CONFIG_SERIAL_8250_MTK_TV=m
CONFIG_PINCTRL_MT5896=m
CONFIG_PINCTRL_MT5896_NARCOS=m
CONFIG_GPIO_MT5896=m
CONFIG_BACKLIGHT_PWM=m
CONFIG_I2C_CHARDEV=m
CONFIG_I2C_GPIO=m
CONFIG_SPI_SPIDEV=m
CONFIG_GATOR=n
CONFIG_PCIE_MS_MTK=m
CONFIG_MTK_TV_ATRACE=m
CONFIG_BT_BNEP=m
CONFIG_BT_BNEP_MC_FILTER=y
CONFIG_BT_BNEP_PROTO_FILTER=y
CONFIG_V4L_TEST_DRIVERS=y
CONFIG_VIDEO_VIM2M=m
CONFIG_V4L_MEM2MEM_DRIVERS=y
CONFIG_LEDS_MEDIATEK_IRTX=m
CONFIG_LEDS_GPIO=m
CONFIG_LEDS_BREATH=m
CONFIG_ION_CMA_HEAP=m
CONFIG_RPMSG_VIRTIO=m
CONFIG_EXTCON=m
CONFIG_EXTCON_MTK_HEADSET=m
CONFIG_MTK_BDMA=m
CONFIG_MT5896_MBOX=m
CONFIG_MT5896_MBOX_MEXICO=m
CONFIG_PM_DEBUG=y
CONFIG_PWM_ADC_MT5896=m
CONFIG_SUPPORT_DV=y
CONFIG_MSTAR_XC_HDR_5_0_0_0=y
CONFIG_MTD_SPI_NOR=y
CONFIG_SPI_SERFLASH_MT5896=m
CONFIG_MTD=y
CONFIG_IIO=y
CONFIG_PM_DEVFREQ=y
```

## drivers/gpu/drm/mediatek/Kconfig
```kconfig
# SPDX-License-Identifier: GPL-2.0-only
config DRM_MEDIATEK
	tristate "DRM Support for Mediatek SoCs"
	depends on DRM
	depends on ARCH_MEDIATEK || (ARM && COMPILE_TEST)
	depends on COMMON_CLK
	depends on HAVE_ARM_SMCCC
	depends on OF
	select DRM_GEM_CMA_HELPER
	select DRM_KMS_HELPER
	select DRM_MIPI_DSI
	select DRM_PANEL
	select MEMORY
	select MTK_SMI
	select VIDEOMODE_HELPERS
	help
	  Choose this option if you have a Mediatek SoCs.
	  The module will be called mediatek-drm
	  This driver provides kernel mode setting and
	  buffer management to userspace.

config DRM_MEDIATEK_HDMI
	tristate "DRM HDMI Support for Mediatek SoCs"
	depends on DRM_MEDIATEK
	select SND_SOC_HDMI_CODEC if SND_SOC
	select GENERIC_PHY
	help
	  DRM/KMS HDMI driver for Mediatek SoCs

config DRM_MEDIATEK_TV
	tristate "DRM Support for Mediatek TV SoCs"
	depends on DRM
	depends on (ARM && COMPILE_TEST)
	depends on COMMON_CLK
	depends on HAVE_ARM_SMCCC
	depends on OF
	select DRM_GEM_CMA_HELPER
	select DRM_KMS_HELPER
	select DRM_PANEL
	select MEMORY
	help
		Choose this option if you have a Mediatek SoCs.
		The module will be called mediatek-drm
		This driver provides kernel mode setting and
		buffer management to userspace.

#config DRM_MEDIATEK_TV_MERAK
#	tristate "Mediatek Video Display DRM SW MERAK Architecture"
#	depends on VIDEO_DEV && VIDEO_V4L2
#	select V4L2_MEM2MEM_DEV
#	default n
#	help
#		Mediatek Video Display DRM SW MERAK Architecture. STI standard
#		interface.
#		To use merak sw architecture, choose y here: the module
#		will be mtk-drm

config CONFIG_DRM_MEDIATEK_TV_LEGACY
	tristate "Mediatek Video Display DRM SW LEGACY Architecture"
	default n
        	help
		Mediatek Video Display DRM SW Legacy Architecture. STI standard
		interface.
		To use legacy sw architecture, choose y here: the module
		will be mtk-drm

source "drivers/gpu/drm/mediatek/mediatek_v2/Kconfig"
```

## drivers/input/keyboard/mtk_ir/Kconfig
```kconfig
config MTK_TV_IR_IN
	tristate "MTK IR_IN Driver"
	default y
	help
	  Say Y here, MTK IR decoder driver function.

	  Say N if you do not use mtk-ir.

	  This will make mrk-ir to hook input
	  subsystem and support input event.

menu "MTK TV IR_IN Config"
	depends on MTK_TV_IR_IN

config MTK_TV_IR_DYNAMIC_CONFIG
	depends on MTK_TV_MIRC_INPUT_DEVICE
	tristate "load ir config(header,protocol,keymap)"
	default n
	help
	  Say Y here to support external keymap.

	  Say N if you do not use ir_config.ini.

	  Add ir_config.ini for customer keymap
	  and support data separation.

config MTK_TV_IR_CONFIG_PATH
	depends on MTK_TV_IR_DYNAMIC_CONFIG
	string "path to ir config"
	default "/config/ir_config.ini"
	help
	  Please set the path to ir_config.ini.

	  for example, add file path to
	  /application/config/ir_config.ini.

config MTK_TV_MIRC_INPUT_DEVICE
	bool "IR Key send to input subsystem"
	default y
        help
	  Say Y hefe, MTK ir will support input subsystem.

	  Say N if you do not use input event.

	  A event node will be created at /dev/input/eventX
	  and the input event of mtk-ir is enabled.

config MTK_TV_IR_DISABLE_REPEAT
	bool "Disable IR repeat key"
	default n
	help
	  Set Y to bypass repeat key.

	  Say N if you need to setup repeat in input event.

	  It will disable repeat bit of this event node
	  from input subsystem.

if MTK_TV_MIRC_INPUT_DEVICE
source "drivers/input/keyboard/mtk_ir/keymaps/Kconfig"
endif

endmenu
```

## drivers/input/keyboard/mtk_ir/keymaps/Kconfig
```kconfig
menu "MTK IR Keymap Select"
	depends on MTK_TV_MIRC_INPUT_DEVICE

	config MTK_TV_IR_KEYMAP_MTK_NEC
		bool "Mtk tv NEC keymaps"
		default y
		help
		  Say Y here, and a keymap of mtk rc will be supported.
		  This option doesn't affect the kernel.

		  If unsure, say Y.

	config IR_KEYMAP_TCL_RCA
		bool "TCL RCA keymaps"
		default n
		help
		TCL RCA keymaps
	config IR_KEYMAP_TCL
		bool "TCL keymaps"
		default n
		help
		TCL tv keymaps
	config IR_KEYMAP_GOME_NEC
		bool "GOME keymaps"
		default n
		help
		GOME tv keymaps
	config IR_KEYMAP_CHANGHONG
		bool "Changhong IR keymaps"
		default n
		help
		Changhong tv keymaps
	config IR_KEYMAP_HISENSE
		bool "Hisense IR keymaps"
		default n
		help
		Hisense tv keymaps
	config IR_KEYMAP_HAIER
		bool "Haier IR keymaps"
		default n
		help
		Haier tv keymaps
	config IR_KEYMAP_KONKA
		bool "Konka IR keymaps"
		default n
		help
		Konka tv keymaps
	config IR_KEYMAP_SKYWORTH
		bool "Skyworth IR keymaps"
		default n
		help
		Skyworth tv keymaps
	config IR_KEYMAP_PANASONIC_7051
		bool "Pnasonic 7051 IR keymaps"
		default n
		help
		panasonic tv keymaps
	config IR_KEYMAP_KATHREIN
		bool "Kathrein RC6 MODE_6A IR keymaps"
		default n
		help
		Kathrein tv keymaps
	config IR_KEYMAP_RC5
		bool "RC5 IR keymaps"
		default n
		help
		RC5 tv keymaps
	config IR_KEYMAP_METZ
		bool "metz IR keymaps"
		default n
		help
		metz tv keymaps
	config IR_KEYMAP_SAMPO
		bool "Sampo IR keymaps"
		default n
		help
		Sampo tv keymaps
	config IR_KEYMAP_BEKO_RC5
		bool "Beko RC5 IR keymaps"
		default n
		help
		Beko RC5 tv keymaps
	config MTK_TV_IR_KEYMAP_SONY
		bool "sony tv keymaps"
		default n
		help
		Sony tv keymaps
endmenu
```

## drivers/media/dvb-frontends/m7332/Kconfig
```kconfig
# SPDX-License-Identifier: (GPL-2.0 OR BSD-3-Clause)

config DVB_M7332
	tristate "MTK M7332 tuner + demodulator"
#	depends on DVB_CORE && SPI
	default m
#	default m if !MEDIA_SUBDRV_AUTOSELECT
	help
	  Say Y when you want to support this frontend.
```

## drivers/media/dvb-frontends/mtk-merak-demod/Kconfig
```kconfig
# SPDX-License-Identifier: GPL-2.0

config CONFIG_DEMOD_MERAK
	tristate "MTK MERAK tuner + demodulator"
#	depends on DVB_CORE && SPI
	default m
#	default m if !MEDIA_SUBDRV_AUTOSELECT
	help
	  Say Y when you want to support this frontend.
```

## drivers/media/platform/mtk-dvb/Kconfig
```kconfig
# SPDX-License-Identifier: (GPL-2.0 OR BSD-3-Clause)
config MEDIATEK_DVB
	bool "Mediatek DVB platform devices"
	depends on MEDIATEK_DVB_ADAPTER
	select VIDEOBUF2_DMA_SG
	select VIDEOBUF2_DMA_CONTIG
	default y
	help
	  To enable mediatek DVB config when
	  MEDIATEK_DVB_DEMUX and
	  MEDIATEK_DVB_ADAPTER
	  are selected.

config MEDIATEK_DVB_ADAPTER
	tristate "Mediatek DVB adapter"
	depends on DVB_PLATFORM_DRIVERS
	default n
	help
	  To enable
	  support for
	  mediatek DVB
	  adapter

config MEDIATEK_DVB_CI
	tristate "Mediatek DVB CI device"
	depends on DVB_PLATFORM_DRIVERS
	default n
	help
	  To enable
	  support for
	  mediatek DVB CI
	  device drivers.

config MEDIATEK_DVB_DEMUX
	tristate "Mediatek DVB demux device"
	depends on DVB_PLATFORM_DRIVERS
	default n
	help
	  To enable
	  support for
	  mediatek DVB demux
	  device drivers.

config MEDIATEK_DVB_DEMUX2
    tristate "Mediatek DVB demux2 device"
    depends on DVB_PLATFORM_DRIVERS
    default n
    help
      To enable
      support for
      mediatek DVB demux2
      device drivers.

config MEDIATEK_DVB_DSCMB
	tristate "Mediatek DVB DSCMB device"
	depends on DVB_PLATFORM_DRIVERS
	default n
	help
	  To enable
	  support for
	  mediatek DVB DSCMB
	  device drivers.

config MEDIATEK_DVB_SC
	tristate "Mediatek DVB SC device"
	depends on DVB_PLATFORM_DRIVERS
	default n
	help
	  To enable support for mediatek DVB SC device drivers.
	  This is suupport ISO 7816-3 spec,
	  only suppourt T=1 for BCAS & ACAS
	  for Japen TV

config MEDIATEK_DVB_SCRAMBLER
    tristate "Mediatek DVB SCRAMBLER device"
    default n
    help
      To enable
      support for mediatek
      DVB SCRAMBLER
      device drivers.
```

## drivers/media/platform/mtk-dvb/ci/Kconfig
```kconfig
config MEDIATEK_DVB_CI
	tristate "Mediatek DVB CI device"
	default n
	help
	  To enable support for mediatek DVB CI device drivers.
```

## drivers/media/platform/mtk-dvb/sc/Kconfig
```kconfig
config MEDIATEK_DVB_SC
	tristate "Mediatek DVB SC device"
	default n
	help
	  To enable support for mediatek DVB SC device drivers.
```

## drivers/media/platform/mtk-earc/Kconfig
```kconfig
config VIDEO_MEDIATEK_EARC
	tristate "Mediatek EARC device"
	select V4L2_MEM2MEM_DEV
	select VIDEOBUF2_DMA_CONTIG
	default n
	help
	  To enable support for mediatek EARC device drivers.
```

## drivers/media/platform/mtk-g2d/Kconfig
```kconfig
config MEDIATEK_G2D
	tristate  "Mediatek G2D"
	default n
	help
	To enable support for mediatek g2d device drivers.
```

## drivers/media/platform/mtk-jpd/Kconfig
```kconfig
config VIDEO_MEDIATEK_JPD
	tristate "Mediatek JPD driver"
	depends on VIDEO_DEV && VIDEO_V4L2
	select VIDEOBUF2_VMALLOC
	select V4L2_MEM2MEM_DEV
	default n
	help
	    Mediatek JPD driver will provide
	    HW capability to decode multiple video formats
	    This driver relys on UTPA driver.

	    To compile this driver as a module, choose M here: the
	    module will be mtk-jpd
```

## drivers/media/platform/mtk-srccap/mt5870/Kconfig
```kconfig
config VIDEO_MEDIATEK_SOURCE_CAPTURE
	tristate "Mediatek Source Capture device"
	select V4L2_MEM2MEM_DEV
	select VIDEOBUF2_DMA_CONTIG
	default n
	help
	  To enable support for mediatek Source Capture device drivers.
```

## drivers/misc/mediatek/headset/Kconfig
```kconfig
config EXTCON_MTK_HEADSET
	tristate "MediaTek Headset Detection Support"
	select EXTCON
	help
	  This option enables extcon support for headset detection
	  on Mediatek DTV platfom with Mediatek headset driver.
	  You will also need to select EXTCON to Y.
	  Say Y here if Mediatek platform need headset detection.
```

## drivers/net/ethernet/mediatek/Kconfig
```kconfig
# SPDX-License-Identifier: GPL-2.0-only
config NET_VENDOR_MEDIATEK
	bool "MediaTek ethernet driver"
	depends on ARCH_MEDIATEK || SOC_MT7621 || SOC_MT7620 || ARCH_MEDIATEK_DTV
	---help---
	  If you have a Mediatek SoC with ethernet, say Y.

if NET_VENDOR_MEDIATEK

config NET_MEDIATEK_SOC
	tristate "MediaTek SoC Gigabit Ethernet support"
	select PHYLINK
	---help---
	  This driver supports the gigabit ethernet MACs in the
	  MediaTek SoC family.

config NET_MEDIATEK_MT5896
	tristate "MediaTek MT5896 Gigabit Ethernet support"
	select MII
	help
	  This driver supports the gigabit ethernet MACs in the
	  MediaTek MT5896.

	  This drive can also be built as a module. If so, the module
	  will be called mtk_gmac_mt5896.
endif #NET_VENDOR_MEDIATEK
```

## drivers/soc/mediatek/mtk-bdma/Kconfig
```kconfig
# SPDX-License-Identifier: GPL-2.0-only

config MTK_BDMA
	tristate "MediaTek BYTE DMA controller support"
	help
	  Enable support for Byte DMA controller on MediaTek
	  SoCs.

	  This controller provides the channels which is dedicated to
	  memory to memory or pattern search.
```

## drivers/soc/mediatek/mtk-memory/Kconfig
```kconfig
config MTK_MEMORY
	tristate "MediaTek Memory Support"
	depends on MTK_MIUP
	default y
        help
	  Say yes here to add support for the MediaTek Memory driver.
```
