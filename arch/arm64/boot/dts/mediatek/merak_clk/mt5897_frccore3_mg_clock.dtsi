// SPDX-License-Identifier: (GPL-2.0 OR BSD-3-Clause)
/*
 * Copyright (c) 2020 MediaTek Inc.
 */

/ {
	frccore3_mux_gate: frccore3_mg {
		#clock-cells = <1>;
		compatible = "mediatek,dtv_clk_mux_gate";
		num = <MT5897_FRCCORE3_NR>;

		frc_core3_frc_fclk_2x_int_ck {
			id = <CLK_FRCCORE3_FRC_CORE3_FRC_FCLK_2X_INT_CK>;
			parents = "frc_fclk_2x_ck","frc_fclk_ck","frc_fclk_2xplus_ck","1'b0";
		};

	};
};
