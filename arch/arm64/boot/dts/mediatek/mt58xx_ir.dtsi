// SPDX-License-Identifier: (GPL-2.0 OR BSD-3-Clause)
/*
 * Copyright (c) 2020 MediaTek Inc.
 */

#include "../../../../../include/dt-bindings/input/linux-event-codes.h"

/ {
	ir_in: ir_in@1C080000{
		compatible = "mtk-ir";
		reg = <0x0 0x1C080000 0 0x200>;
		interrupt-parent = <&mtk_intc2_fiq_high>;
		interrupts = <0x0 0x15 0x4>,
		<0x0 0x16 0x4>;
		status = "disable";
		ir_keymap0 {
			protocol = <1>;//IR_TYPE_NEC;
			keymap_name = "mtk-tv";
			customercode = <0x807f>;
			ir_key_table =
			<
				KEY_POWER	0x46
				KEY_0		0x50
				KEY_1		0x49
				KEY_2		0x55
				KEY_3		0x59
				KEY_4		0x4D
				KEY_5		0x51
				KEY_6		0x5D
				KEY_7		0x48
				KEY_8		0x54
				KEY_9		0x58
				KEY_RED		0x47
				KEY_GREEN	0x4B
				KEY_YELLOW	0x57
				KEY_BLUE	0x5B
				KEY_UP		0x52
				KEY_DOWN	0x13
				KEY_LEFT	0x06
				KEY_RIGHT	0x1A
				KEY_ENTER	0x0F
				KEY_CHANNELUP	0x1F
				KEY_CHANNELDOWN	0x19
				KEY_VOLUMEUP	0x16
				KEY_VOLUMEDOWN	0x15
				KEY_PAGEUP	0x03
				KEY_PAGEDOWN	0x05
				KEY_HOME	0x17
				KEY_MENU	0x07
				KEY_BACK	0x1B
				KEY_MUTE	0x5A
				KEY_RECORD	0x0D
				KEY_HELP	0x42
				KEY_INFO	0x14
				KEY_KP0		0x40
				KEY_KP1		0x04
				KEY_ASSISTANT	0x21
				KEY_REWIND	0x0E
				KEY_FORWARD	0x12
				KEY_PREVIOUSSONG	0x02
				KEY_NEXTSONG	0x1E
				KEY_PLAY	0x01
				KEY_PAUSE	0x1D
				KEY_STOP	0x11
				KEY_AUDIO	0x44
				KEY_CAMERA	0x56
				KEY_ZOOM	0x4C
				KEY_CHANNEL	0x5C
				KEY_SLEEP	0x45
				KEY_EPG		0x4A
				KEY_LIST	0x10
				KEY_SUBTITLE	0x53
				KEY_FN_F1	0x41
				KEY_FN_F1	0x26
				KEY_FN_F2	0x4E
				KEY_FN_F3	0x0A
				KEY_FN_F3	0x23
				KEY_FN_F4	0x09
				KEY_FN_F5	0x1C
				KEY_FN_F6	0x08
				KEY_F1		0x0B
				KEY_F2		0x18
				KEY_F3		0x00
				KEY_F4		0x0C
				KEY_F5		0x4F
				KEY_F6		0x5E
				KEY_F7		0x43
				KEY_F8		0x5F
				KEY_POWER2	0xFE
				KEY_OK		0xFF
				KEY_F12		0x22
				KEY_F20		0x64
				KEY_FAVORITES	0x24
				KEY_FN_F8	0x31
				KEY_FN_F9	0x32
				KEY_AUDIO_DESC	0x25
				>;
			};

		};
};

