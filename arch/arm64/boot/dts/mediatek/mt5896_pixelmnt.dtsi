// SPDX-License-Identifier: (GPL-2.0 OR BSD-3-Clause)
/*
 * Copyright (c) 2020 MediaTek Inc.
 */

/ {
	#address-cells = <2>;
	#size-cells = <2>;

	pixelmonitor: pixelmonitor {
		compatible = "mediatek,pixelmonitor";
		max_window = <0x10>;
		max_point = <0x0B>;
	};
};
